## main/Kconfig.projbuild
```kconfig
menu "CSI config"

    choice

        prompt "Select the CSI App type"
        default CSI_APP_TYPE_DEFAULT

        config CSI_APP_TYPE_DEFAULT
            bool "Default"
            help
              No CSI App type selected (init manager only)

        config CSI_APP_TYPE_SENDER
            bool "Sender"
            help
              Sender CSI App type

        config CSI_APP_TYPE_RECEIVER
            bool "Receiver"
            help
              Receiver CSI App type

    endchoice

    config LESS_INTERFERENCE_CHANNEL
        int "Less interference channel"
        default 11
        help
            Set channel with less interference while compiling application for receiver device

    config SEND_FREQUENCY
        int "Sender frequency"
        default 100
        help
            Set frequency while compiling application for sender device
endmenu
```
